## conf/bblayers.conf
```bitbake
# POKY_BBLAYERS_CONF_VERSION is increased each time build/conf/bblayers.conf
# changes incompatibly
POKY_BBLAYERS_CONF_VERSION = "2"

BBPATH = "${TOPDIR}"
BBFILES ?= ""

BBLAYERS ?= " \
  /home/abhilasha/yocto_project/yocto/source/poky/meta \
  /home/abhilasha/yocto_project/yocto/source/poky/meta-poky \
  /home/abhilasha/yocto_project/yocto/source/poky/meta-yocto-bsp \
  /home/abhilasha/yocto_project/yocto/source/meta-mylayer \
  /home/abhilasha/yocto_project/yocto/source/meta-demo \
  /home/abhilasha/yocto_project/yocto/source/meta-raja \
  /home/abhilasha/yocto_project/yocto/source/meta-rba5d2x \
  /home/abhilasha/yocto_project/yocto/source/meta-openembedded \
  /home/abhilasha/yocto_project/yocto/source/meta-openembedded/meta-oe \
 /home/abhilasha/yocto_project/yocto/source/meta-openembedded/meta-python \
 /home/abhilasha/yocto_project/yocto/source/meta-openembedded/meta-networking \
 "
```

## source/meta-raja/conf/layer.conf
```bitbake
# We have a conf and classes directory, add to BBPATH
BBPATH .= ":${LAYERDIR}"

# We have recipes-* directories, add to BBFILES
BBFILES += "${LAYERDIR}/recipes-*/*/*.bb \
            ${LAYERDIR}/recipes-*/*/*.bbappend"

BBFILE_COLLECTIONS += "meta-raja"
BBFILE_PATTERN_meta-raja = "^${LAYERDIR}/"
BBFILE_PRIORITY_meta-raja = "6"

LAYERDEPENDS_meta-raja = "core"
LAYERSERIES_COMPAT_meta-raja = "kirkstone"
```
